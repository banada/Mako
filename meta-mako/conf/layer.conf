## meta-mako/conf/layer.conf
```bitbake
# We have a conf and classes directory, add to BBPATH
BBPATH .= ":${LAYERDIR}"

# We have recipes-* directories, add to BBFILES
BBFILES += "${LAYERDIR}/recipes-*/*/*.bb \
	${LAYERDIR}/recipes-*/*/*.bbappend"

BBFILE_COLLECTIONS += "mako"
BBFILE_PATTERN_mako = "^${LAYERDIR}/"
BBFILE_PRIORITY_mako = "6"

#versions compatible with Node-RED
PREFERRED_VERSION_nodejs = "0.10.25"
PREFERRED_VERSION_mraa = "0.7.2"
PREFERRED_VERSION_upm = "0.3.1"

#systemd
DISTRO_FEATURES_append = " systemd bluez5"
VIRTUAL-RUNTIME_init_manager = "systemd"
DISTRO_FEATURES_BACKFILL_CONSIDERED = "sysvinit"
VIRTUAL-RUNTIME_initscripts = ""
```
